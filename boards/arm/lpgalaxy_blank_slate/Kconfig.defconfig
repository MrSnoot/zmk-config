## boards/arm/lpgalaxy_blank_slate/Kconfig.defconfig
```kconfig
# Copyright (c) 2020 Pete Johanson
# SPDX-License-Identifier: MIT

if BOARD_LPGALAXY_BLANK_SLATE

config ZMK_SPLIT_ROLE_CENTRAL
    default n

config ZMK_SPLIT
    default y

endif # BOARD_LPGALAXY_BLANK_SLATE
```

## boards/shields/lpgalaxy_blank_slate/Kconfig.shield
```kconfig
config SHIELD_LPGALAXY_BLANK_SLATE_DONGLE
    def_bool $(shields_list_contains,lpgalaxy_blank_slate_dongle)
```

## config/west.yml
```yaml
manifest:
  remotes:
    - name: zmkfirmware
      url-base: https://github.com/zmkfirmware
    - name: petejohanson
      url-base: https://github.com/petejohanson
    - name: urob
      url-base: https://github.com/urob
    - name: carrefinho
      url-base: https://github.com/carrefinho
  projects:
    - name: zmk
      remote: zmkfirmware
      revision: v0.3
      import: app/west.yml
    - name: blank-slate-zmk-module
      remote: petejohanson
      revision: v0.3
    - name: zmk-auto-layer
      remote: urob
      revision: v0.3
    - name: prospector-zmk-module
      remote: carrefinho
      revision: main
  self:
    path: config
```
